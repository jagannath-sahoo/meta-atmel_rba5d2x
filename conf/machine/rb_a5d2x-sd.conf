## conf/machine/rb_a5d2x-sd.conf
```bitbake
#@TYPE: Machine
#@Name: ATMEL SAMA5D2 SOM1 EK SD
#@DESCRIPTION: Machine configuration for Atmel/Microchip's evaluation board

require include/sama5d2.inc

MACHINE_FEATURES = "apm alsa ext2 ext3 usbhost usbgadget touchscreen"
KERNEL_DEVICETREE = " \
		at91-rugged_board_a5d2x.dtb \
		"

do_image_wic[depends] += "u-boot-at91:do_deploy"
IMAGE_FSTYPES += " tar.gz wic"
WKS_FILE = "sdimage-bootpart.wks"

IMAGE_BOOT_FILES = "BOOT.BIN u-boot.bin uboot.env rugged_board_a5d2x.dtb \
                    "

UBOOT_MACHINE ?= "rb_a5d2x_mmc1_defconfig"
UBOOT_ENTRYPOINT = "0x20008000"
UBOOT_LOADADDRESS = "0x20008000"
UBOOT_ENV_SIZE = "0x4000"

AT91BOOTSTRAP_MACHINE ?= "rugged_board_a5d2xsd1"

# Needed for FIT
#MACHINE_ESSENTIAL_EXTRA_RDEPENDS = " dt-overlay-at91"
```
